## firmware/helmet_p4/main/Kconfig.projbuild
```kconfig
menu "HANMIR P4 integration"
    config HANMIR_WIFI_SSID
        string "2.4 GHz Wi-Fi SSID"
        default ""
    config HANMIR_WIFI_PASSWORD
        string "Wi-Fi password"
        default ""
    config HANMIR_SERVER_HOST
        string "FastAPI server IPv4 address or DNS name"
        default ""
    config HANMIR_SERVER_PORT
        int "FastAPI port"
        range 1 65535
        default 8000
    config HANMIR_DEVICE_ID
        string "AV device ID"
        default "helmet-001-av"
    config HANMIR_ORGANIZATION_ID
        string "Organization ID"
        default "org-001"
    config HANMIR_SITE_ID
        string "Site ID"
        default "site-001"
    config HANMIR_WORKER_ID
        string "Worker ID"
        default "worker-001"
    config HANMIR_HELMET_ID
        string "Helmet ID"
        default "helmet-001"
    config HANMIR_CAMERA_TOKEN
        string "Camera stream token: match backend CAMERA_INGEST_TOKEN"
        default ""
    config HANMIR_CAMERA_HTTP_BASELINE
        bool "Use existing multipart POST camera endpoint for S3/P4 baseline comparison"
        default n
    config HANMIR_ENABLE_VOICE
        bool "Enable INMP441 AFE and server voice clips"
        default n
    config HANMIR_SPK_BCLK_GPIO
        int "Verified MAX98357A BCLK GPIO (-1 disables)"
        default -1
    config HANMIR_SPK_WS_GPIO
        int "Verified MAX98357A WS GPIO (-1 disables)"
        default -1
    config HANMIR_SPK_DATA_GPIO
        int "Verified MAX98357A DIN GPIO (-1 disables)"
        default -1
    config HANMIR_MIC_BCLK_GPIO
        int "Verified INMP441 BCLK GPIO; -1 disables microphone"
        default -1
    config HANMIR_MIC_WS_GPIO
        int "Verified INMP441 WS GPIO"
        default -1
    config HANMIR_MIC_DATA_GPIO
        int "Verified INMP441 DATA GPIO"
        default -1
    config HANMIR_ENABLE_NS
        bool "ESP-SR WebRTC noise suppression"
        default y
    config HANMIR_ENABLE_WAKENET
        bool "Log WakeNet hits (requires verified model; does not bypass server gate)"
        default n
    config HANMIR_CAMERA_MAX_BYTES
        int "Maximum JPEG bytes queued for stream"
        range 1024 524288
        default 262144
    config HANMIR_BAT_SDA_GPIO
        int "Verified MAX17048 SDA GPIO (-1 disables)"
        default -1
    config HANMIR_BAT_SCL_GPIO
        int "Verified MAX17048 SCL GPIO (-1 disables)"
        default -1
    config HANMIR_IMU_RX_GPIO
        int "Verified BNO085 sensor TX to P4 RX GPIO (-1 disables)"
        default -1
    config HANMIR_IMU_TX_GPIO
        int "Verified BNO085 sensor RX to P4 TX GPIO (-1 disables)"
        default -1
endmenu
```

## firmware/helmet_p4/sdkconfig.defaults
```kconfig
CONFIG_ESPTOOLPY_FLASHSIZE_16MB=y
CONFIG_PARTITION_TABLE_CUSTOM=y
CONFIG_PARTITION_TABLE_CUSTOM_FILENAME="partitions.csv"
CONFIG_SPIRAM=y
CONFIG_ESP32P4_SELECTS_REV_LESS_V3=y
CONFIG_ESP32P4_REV_MIN_100=y
CONFIG_ESP_CONSOLE_USB_SERIAL_JTAG=y
CONFIG_ESP_WIFI_REMOTE_ENABLED=y
CONFIG_SLAVE_IDF_TARGET_ESP32C6=y
CONFIG_ESP_HOSTED_HOST_TRANSPORT_BUS_SDIO=y
CONFIG_ESP_HOSTED_HOST_SDIO_BUS_WIDTH_4=y
CONFIG_ESP_HOSTED_HOST_SDIO_PIN_CLK=18
CONFIG_ESP_HOSTED_HOST_SDIO_PIN_CMD=19
CONFIG_ESP_HOSTED_HOST_SDIO_PIN_D0=14
CONFIG_ESP_HOSTED_HOST_SDIO_PIN_D1=15
CONFIG_ESP_HOSTED_HOST_SDIO_PIN_D2=16
CONFIG_ESP_HOSTED_HOST_SDIO_PIN_D3=17
CONFIG_ESP_HOSTED_HOST_RESET_GPIO=54
# Avoid serializing full-duplex call writes behind a blocking socket read.
CONFIG_ESP_WS_CLIENT_SEPARATE_TX_LOCK=y
# Reduce JPEG WebSocket fragmentation without changing image quality.
CONFIG_HANMIR_CAMERA_WS_BUFFER_BYTES=65536
CONFIG_HANMIR_IMU_FALL_SHADOW=y
CONFIG_HANMIR_POSTURE_TILT_DEG=60
CONFIG_HANMIR_POSTURE_HOLD_MS=3000
```

## firmware/helmet_p4_voice_lab/main/Kconfig.projbuild
```kconfig
menu "HANMIR P4 voice lab"

    config HANMIR_MIC_BCLK_GPIO
        int "INMP441 bit clock GPIO (verify on actual board)"
        default -1

    config HANMIR_MIC_WS_GPIO
        int "INMP441 word select GPIO (verify on actual board)"
        default -1

    config HANMIR_MIC_DATA_GPIO
        int "INMP441 data GPIO (verify on actual board)"
        default -1

    config HANMIR_ENABLE_NS
        bool "ESP-SR WebRTC noise suppression"
        default y

    config HANMIR_ENABLE_WAKENET
        bool "Log detections from a selected WakeNet model"
        default n
        help
            Enable only after a model has been selected and flashed through
            ESP Speech Recognition menuconfig. A generic model does NOT
            recognize Korean '투투스' or emergency phrases.

    config HANMIR_STREAM_PCM
        bool "Print AFE output as base64 PCM lines for host-side WAV capture"
        default n
        help
            Lab use only. Printing audio may block the real-time fetch task.
            Use the board's fast USB console and disable for latency tests.

endmenu
```
